## main/Kconfig.projbuild
```kconfig
menu "Example Configuration"
	config EXAMPLE_FILESYSTEM_TYPE
		string
		default "None" if EXAMPLE_FS_TYPE_NONE
		default "SPIFFS" if EXAMPLE_FS_TYPE_SPIFFS
		default "FatFS" if EXAMPLE_FS_TYPE_FAT
		default "LittleFS" if EXAMPLE_FS_TYPE_LFS

		choice
			prompt "RW filesystem type"
			default EXAMPLE_FS_TYPE_NONE
			help
				Select read-write internal file system type.  It is overlayed on the read-only fs.
				
			config EXAMPLE_FS_TYPE_NONE
				bool "None"
#			config EXAMPLE_FS_TYPE_SPIFFS
#				bool "SPIFFS"
			config EXAMPLE_FS_TYPE_FAT
				bool "FatFS"
#			config EXAMPLE_FS_TYPE_LFS
#				bool "LittleFS"
		endchoice
		
	config EXAMPLE_RO_FILESYSTEM_TYPE
		string
		default "None" if EXAMPLE_ROFS_TYPE_NONE
		default "ESPFS" if EXAMPLE_ROFS_TYPE_ESPFS

		choice
			prompt "RO filesystem type"
			default EXAMPLE_ROFS_TYPE_NONE
			help
				Select read-only file system type.  It is the base fs compiled into the image.
				
			config EXAMPLE_ROFS_TYPE_NONE
				bool "None"
			config EXAMPLE_ROFS_TYPE_ESPFS
				bool "ESPFS"
		endchoice
endmenu
```

## sdkconfig.defaults
```kconfig
#
# Bluetooth
#
CONFIG_BT_ENABLED=y

#
# Bluetooth controller
#
CONFIG_BTDM_CONTROLLER_MODE_BLE_ONLY=y

#
# Serial flasher config
#
CONFIG_ESPTOOLPY_BAUD_921600B=y
CONFIG_ESPTOOLPY_BAUD=921600
CONFIG_ESPTOOLPY_FLASHSIZE_4MB=y
CONFIG_ESPTOOLPY_FLASHSIZE="4MB"

#
# File systems
#
CONFIG_EXAMPLE_FILESYSTEM_TYPE="FatFS"
CONFIG_EXAMPLE_FS_TYPE_NONE=
CONFIG_EXAMPLE_FS_TYPE_SPIFFS=
CONFIG_EXAMPLE_FS_TYPE_FAT=y
CONFIG_EXAMPLE_FS_TYPE_LFS=

#
# Partition Table
#
CONFIG_PARTITION_TABLE_CUSTOM=y
CONFIG_PARTITION_TABLE_CUSTOM_FILENAME="partitions_fatfs_4M.csv"
CONFIG_PARTITION_TABLE_FILENAME="partitions_fatfs_4M.csv"

#
# SPIFFS Configuration
#
CONFIG_SPIFFS_MAX_PARTITIONS=1
CONFIG_SPIFFS_OBJ_NAME_LEN=64

#
# FatFS
#

CONFIG_FATFS_LFN_HEAP=y
CONFIG_FATFS_MAX_LFN=127

#
# Wear Levelling
#
CONFIG_WL_SECTOR_SIZE_512=
CONFIG_WL_SECTOR_SIZE_4096=y
CONFIG_WL_SECTOR_SIZE=4096

#
# espfs
#
CONFIG_ESPFS_IMAGEROOTDIR="fs/espfs"
CONFIG_ESPFS_USE_HEATSHRINK=
CONFIG_ESPFS_USE_GZIP=
CONFIG_ESPFS_USE_MINIFY_TOOLS=
```
